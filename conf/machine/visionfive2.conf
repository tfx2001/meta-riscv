## conf/machine/visionfive2.conf
```bitbake
#@TYPE: Machine
#@NAME: visionfive2
#@SOC: StarFive JH7110
#@DESCRIPTION: Machine configuration for the VisionFive 2 board

require include/jh7110-common.inc

#============================================
# SBI Configuration
RISCV_SBI_FDT ?= "jh7110-visionfive-v2.dtb"
#============================================

#============================================
# Kernel Configuration
KERNEL_IMAGETYPE = "Image.gz"
KERNEL_DEVICETREE ?= "starfive/jh7110-visionfive-v2.dtb"
#============================================

#============================================
# Uboot Configuration
UBOOT_MACHINE = "starfive_visionfive2_defconfig"
UBOOT_DTB_BINARY = "starfive_visionfive2.dtb"
UBOOT_EXTLINUX = "1"
UBOOT_EXTLINUX_FDT = "/dtbs/${KERNEL_DEVICETREE}"
UBOOT_EXTLINUX_ROOT = "root=/dev/mmcblk1p4"
UBOOT_EXTLINUX_CONSOLE = "console=tty1 console=ttyS0,115200 earlycon=sbi"
UBOOT_EXTLINUX_KERNEL_ARGS = "rootwait rw debug"
#============================================
```
